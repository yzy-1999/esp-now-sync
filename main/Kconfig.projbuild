## main/Kconfig.projbuild
```kconfig
menu "Example Configuration"

    choice ESPNOW_WIFI_MODE
        prompt "WiFi mode"
        default ESPNOW_WIFI_MODE_STATION
        help
            WiFi mode(station or softap).

        config ESPNOW_WIFI_MODE_STATION
            bool "Station"
        config ESPNOW_WIFI_MODE_STATION_SOFTAP
            bool "Softap"
    endchoice

    config ESPNOW_PMK
        string "ESPNOW primary master key"
        default "pmk1234567890123"
        help
            ESPNOW primary master for the example to use. The length of ESPNOW primary master must be 16 bytes.

    config ESPNOW_LMK
        string "ESPNOW local master key"
        default "lmk1234567890123"
        help
            ESPNOW local master for the example to use. The length of ESPNOW local master must be 16 bytes.

    config ESPNOW_CHANNEL
        int "Channel"
        default 1
        range 0 14
        help
            The channel on which sending and receiving ESPNOW data.

    config ESPNOW_SEND_COUNT
        int "Send count"
        default 100
        range 1 65535
        help
            Total count of unicast ESPNOW data to be sent.

    config ESPNOW_SEND_DELAY
        int "Send delay"
        default 1000
        range 0 65535
        help
            Delay between sending two ESPNOW data, unit: ms.

    config ESPNOW_SEND_LEN
        int "Send len"
        range 10 1470
        default 10
        help
            Length of ESPNOW data to be sent, unit: byte.

    config ESPNOW_ENABLE_LONG_RANGE
        bool "Enable Long Range"
        default "n"
        help
            When enable long range, the PHY rate of ESP32 will be 512Kbps or 256Kbps

    config ESPNOW_ENABLE_POWER_SAVE
        bool "Enable ESPNOW Power Save"
        default "n"
        select ESP_WIFI_STA_DISCONNECTED_PM_ENABLE
        depends on ESPNOW_WIFI_MODE_STATION
        help
            With ESPNOW power save enabled, chip would be able to wakeup and sleep periodically
            Notice ESP_WIFI_STA_DISCONNECTED_PM_ENABLE is essential at Wi-Fi disconnected

    config ESPNOW_WAKE_WINDOW
        int "ESPNOW wake window, unit in millisecond"
        range 0 65535
        default 50
        depends on ESPNOW_ENABLE_POWER_SAVE
        help
            ESPNOW wake window

    config ESPNOW_WAKE_INTERVAL
        int "ESPNOW wake interval, unit in millisecond"
        range 1 65535
        default 100
        depends on ESPNOW_ENABLE_POWER_SAVE
        help
            ESPNOW wake interval

endmenu

menu "Time Synchronization Configuration"

    config TIME_SYNC_MASTER_MAC
        string "Master Device MAC Address"
        default "FC:01:2C:F9:0E:F0"
        help
            Set the MAC address of the master (time server) device.
            All other devices will automatically become slaves.

    config TIME_SYNC_INTERVAL
        int "Sync Interval (ms)"
        range 1000 60000
        default 10000
        help
            Time synchronization interval in milliseconds for slave devices.
            
    config TIME_SYNC_TIMEOUT
        int "Sync Timeout (ms)"
        range 1000 30000
        default 5000
        help
            Timeout for synchronization requests in milliseconds.
            
    config TIME_SYNC_ENABLE_FILTER
        bool "Enable Time Filtering"
        default y
        help
            Enable filtering to smooth out time synchronization measurements.
            This improves stability but may increase convergence time.
            
    config TIME_SYNC_FILTER_SIZE
        int "Filter History Size"
        range 4 16
        default 8
        depends on TIME_SYNC_ENABLE_FILTER
        help
            Number of historical measurements to use for filtering.

endmenu
```
